## Kconfig
```kconfig
menuconfig BASEWORK
    bool "Low level Base library"
    default y

if BASEWORK

rsource "os/Kconfig"

config SYS_NVRAM_ATTRIBUTE
    string "No-volatile ram section"
    default ".noinit.system.nvram"

config HFSM_SUPPORT
    bool "Enable hierarchical support for FSM"
    default n

config SMALL_MEM_MODEL
    bool "Enable small memory model"
    default n

config ENCODER_INPUT_FRAMEWORK
    bool "Enable encoder input framework"
    default y

config BACKUP_RAM_SIZE
    int "The size nvram of system"
    default 5120

config USER_PARTITION
    bool "Enable user partitions"
    default y

config CORTEXM_DWT
    bool "Enable watchpoint for cortexm cpu"

config FTRACE
    bool "Enable function trace"

config PERFORMANCE_PROFILE
    bool "Enable function performance profile"
    depends on FTRACE

config FRACE_NVRAM
    bool "Enable nvram buffer for function trace"
    depends on FTRACE
    default n

config BASEWORK_MEM_SIZE
    int "The memory pool size of general allocator"
    default 65536

config GTEST
    bool "The google code test framework"
    select CPLUSPLUS
    select LIB_CPLUSPLUS
    select POSIX_API
    select PTHREAD_IPC

config BASEWORK_TEST
    bool "Enable test case for basework"
    depends on GTEST
    default n

config BASEWORK_RQ_PRIORITY
    int "Run queue task priority"
    range 0 15
    default 7

config BASEWORK_RQ_STACK_SIZE
    int "Run queue task stack size"
    range 1000 16384
    default 4096

config BASEWORK_RQ_CAPACITY
    int "The maximum node numbers of run-queue"
    default 200

config MAX_MESSAGES
    int "The maximum limit for messages"
    default 30

config MAX_MESSAGE_TYPES
    int "The maximum limit for message types"
    default 50

rsource "package/Kconfig"
rsource "dev/Kconfig"
rsource "ui/Kconfig"
rsource "lib/Kconfig"

menuconfig BASEWORK_TOOLS
    bool "Debugging Tools"
    default n

if BASEWORK_TOOLS
config FLASHTRACE
    bool "Trace flash operation"
    default n

config FLASHTRACE_LOGSZ
    int "Hash pool log size"
    depends on FLASHTRACE
    default 8

config FLASHTRACE_ELEMNUMS
    int "Hash node numbers"
    depends on FLASHTRACE
    default 2000

endif #BASEWORK_TOOLS

config TEMPERATURE
    bool "Enable Temperature modoule"
    default n

if TEMPERATURE
config TEMPERATURE_AS6221
    bool "Enable temperature drive as6221"
    default n
endif

rsource "debug/Kconfig"

rsource "thirdparty/Kconfig"

endif #BASEWORK
```

## debug/Kconfig
```kconfig
menu "System debug"

menuconfig KASAN
    bool "Enable address sanitizer"
    default n

if KASAN
config ASAN_SHADOW_SECTION
    string "The section of Shadow area"
    default ".bss.shadow.mem"

config ASAN_REDZONE_SIZE
    int "The size of red-zone"
    default 8

config ASAN_MEM_BASE
    hex "The starting address to be protected"
    default 0

config ASAN_MEM_SIZE
    hex "The size of protected area"
    default 0x10000

endif  #KASAN

endmenu
```

## dev/Kconfig
```kconfig
menu "Block Device"

config DISK_SAFEAPI
    bool "Enable disk-operation API safe-checker"
    default y

config BLKDEV_LITE
    bool "The block device for small footpoint memory"
    default n

config BLKDEV_ERASE_BLKSZ
    int "The block device eraseable size"
    depends on BLKDEV_LITE
    default 4096

config BLKDEV_WRSIZE
    int "The write block size"
    depends on BLKDEV_LITE
    default 256
    help
        This option is used to reduce data size that 
        write into flash device

if !BLKDEV_LITE
config BLKDEV_NR_BUFS
    int "The block device buffer numbers"
    range 1 20
    default 4

config BLKDEV_MAX_BLKSZ
    int "The maximum block size for block device"
    default 4096

config BLKDEV_SWAP_PERIOD
    int "Block device sync period with milliseconds"
    default 3000

config BLKDEV_HOLD_TIME
    int "Block device data hold time with millisecond"
    default 10000
endif #BLKDEV_LITE

menuconfig PTFS
    bool "filesystem based parition table"
    default n
    help
      This is simple filesystem that partiton based and
      just only design for large file read/write 
     
if PTFS
config PTFS_SIZE
    int "File parition size"
    default 3145728

config PTFS_INODE_SIZE
    int "File index space size"
    default 4096

config PTFS_BLKSIZE
    int "File partition block size"
    default 65536

config PTFS_MAXFILES
    int "Maximum files"
    default 6

endif #PTFS

menuconfig XIPFS
    bool "Enable xip filesystem"
    default n
    help
        This option is enable xip filesystem that can make
        sure the file content is continuity
     
if XIPFS
config XIPFS_SIZE
    int "File parition size"
    default 3145728

config XIPFS_BLKSIZE
    int "File partition block size"
    default 32768

config XIPFS_MAXFILES
    int "Maximum files"
    default 15

endif #XIPFS

menuconfig CUSTOM_PT_TABLE
    bool "Enable custom partition table"
    default n

if CUSTOM_PT_TABLE

config MAJOR_PT_FILE
    string "The major partition configuration file"
    default "config/major_ptcfg_default.h"

config MINOR_PT_FILE
    string "The minor partition configuration file"
    default "config/minor_ptcfg_default.h"

config MINOR_PT2_FILE
    string "The minor partition configuration file 2"
    default "config/minor_ptcfg2_default.h"
    help
      This partition can not be erased when the system 
      reset factory settings

endif #CUSTOM_PT_TABLE

config FIFOFS_CHECKER_DISABLE
    bool "Disable fifofs parameter checker"
    default y
    
endmenu
```

## lib/Kconfig
```kconfig
menu "Library"

config MSG_STORAGE_CHECKSUM
    bool "Enable message checksum"
    default n

config DISKLOG_BIO
    bool "Enable buffered i/o for disklog"
    default y

config DISKLOG_SWAP_PERIOD
    int "Disk log swap period in milliseconds"
    default 43200000

endmenu
```

## os/Kconfig
```kconfig
menu "Operation System Abstract Layer"

menuconfig PTFILE_MOUNT_TABLE
    bool "Enable partition filesystem mount table"
    default n

if PTFILE_MOUNT_TABLE
config PTFILE_MOUNT_HEADER
    string "The header file of partition mount data"
    default "xxxx.h"
endif

config OS_MAX_TIMERS
    int "The maximum timers"
    default 30
    help
        This option is limit maximum timers that can be created
        at the same time

config OS_MAX_FILES
    int "The maximum files"
    default 10
    help
        This option is limit maximu files that can be opend at
        the same time

config OS_TIMER_TRACER
    bool "Enable timer tracer"
    default n

config VFS_PARAM_CHECKER
    bool "Enable parameter checker for VFS"
    default n

config IOBUS_PARAM_CHECKER
    bool "Enable paramter checker for iobus"
    default n
        
endmenu
```

## package/Kconfig
```kconfig
menuconfig SCREEN_MANAGER
    bool "screen state manager"
    default y

if SCREEN_MANAGER

config SCREEN_ACTIVE_TIMEOUT
    int "screen active timeout with seconds"
    range 5 3600
    default 10

config SCREEN_STANDBY_TIMEOUT
    int "screen standby timeout with seconds"
    range 0 3600
    default 5

config SCREEN_POST_DELAY
    int "screen extra active time with milliseconds"
    default 0
    help
      This option is used to increase the activity time to avoid 
      the screen not refreshing

config SCREEN_STANDBY_BRIGHTNESS
    int "screen brightness in standby mode"
    range 10 255
    default 60
    help
      This option just only valid when screen standby 
      mode has been enabled

endif
```

## thirdparty/Kconfig
```kconfig
menu "Thirdparty Library"

menuconfig LUA
    bool "Enable lua VM"
    default n
    help
        This option is enable lua script interpreter

if LUA
config LUA_PACKAGE
    bool "Enable package"
    default n

config LUA_COROUTINE
    bool "Enable coroutine"
    default n

config LUA_TABLE
    bool "Enable table"
    default n

config LUA_IO
    bool "Enable standard IO"
    default n

config LUA_OS
    bool "Enable os library support"
    default n
    
config LUA_MATH
    bool "Enable math library"
    default n

config LUA_UTF8
    bool "Enable UTF8 code"
    default n

config LUA_DEBUG
    bool "Enable debug information"
    default n

endif #LUA

menuconfig LZ4
    bool "Enable LZ4 compression"
    default y

config CJSON
    bool "Enable cJson library"
    default y

config FLASHDB
    bool "Enable key-value based nvram"
    default y

endmenu
```

## thirdparty/filexfs/Kconfig
```kconfig
menuconfig FILE_SYSTEM_FILEXFS
    bool "FileX filesystem"
    default n

if FILE_SYSTEM_FILEXFS

config FS_FILEX_NUM_DIRS
    int "The maximum number of directories"
    default 3

config FS_FILEX_NUM_FILES
    int "The maximum number of files"
    default 3

config FS_FILEX_MEDIA_BUFFER_SIZE
    int "The cache size for filesystem"
    default 4096

config FX_MAX_LONG_NAME_LEN
    int "The maximum size of long file names"
    range 13 256
    default 256

config FX_MAX_LAST_NAME_LEN
    int "The maximum size of long file names"
    range 13 256
    default 256
    help
        Must be as large or larger than FX_MAX_LONG_NAME_LEN

config FX_MAX_SECTOR_CACHE
    int "The maximum number of logical sectors that can be cached by FileX"
    range 2 4294967296
    default 256
    help
        Minimum value is 2, all other values must be power of 2.

config FX_FAT_MAP_SIZE
    int "The size in bytes of the bit map used to update the secondary FAT sectors"
    default 128
    help
        The larger the value the less unnecessary secondary FAT sector writes.

config FX_MAX_FAT_CACHE
    int "The number of entries in the FAT cache"
    default 16
    help
        Minimum value is 8, all values must be a power of 2.

config FX_UPDATE_RATE_IN_SECONDS
    int "The number of seconds the time parameters are updated in FileX"
    default 10

config FX_NO_TIMER
    bool "Disable timer for FileX to update time"
    default n

config FX_DONT_UPDATE_OPEN_FILES
    bool "FileX does not update already opened files"
    default n

config FX_MEDIA_DISABLE_SEARCH_CACHE
    bool "the file search cache optimization is disabled"
    default n

config FX_DISABLE_DIRECT_DATA_READ_CACHE_FILL
    bool "The direct read sector update of cache is disabled"
    default n

config FX_MEDIA_STATISTICS_DISABLE
    bool "Gathering of media statistics is disabled"
    default y

config FX_SINGLE_OPEN_LEGACY
    bool "Legacy single open logic for the same file is enabled"
    default n

config FX_RENAME_PATH_INHERIT
    bool "Renaming inherits path information"
    default n

config FX_NO_LOCAL_PATH
    bool "Local path logic is disabled"
    default y

config FX_SINGLE_THREAD
    bool "Enable single thread model"
    default n

config FX_FAULT_TOLERANT_DATA
    bool "Data sector write requests are flushed immediately to the driver"
    default n

config FX_FAULT_TOLERANT
    bool "System sector write requests are flushed immediately to the driver"
    default n
    help
        system sector write requests (including FAT and directory entry requests)
        are flushed immediately to the driver

config FX_DRIVER_USE_64BIT_LBA
    bool "Enables 64-bits sector addresses used in I/O driver"
    default n

config FX_ENABLE_FAULT_TOLERANT
    bool "Enables FileX fault tolerant service"
    default n

config FX_DISABLE_ERROR_CHECKING
    bool "Error checking is disabled"
    default y

config FX_DISABLE_CACHE
    bool "Cache is disabled"
    default n

config FX_DISABLE_FILE_CLOSE
    bool "File close is disabled"
    default n

config FX_DISABLE_FAST_OPEN
    bool "Fast open is disabled"
    default n

config FX_DISABLE_FORCE_MEMORY_OPERATION
    bool "Force memory operations are disabled"
    default n

config FX_DISABLE_BUILD_OPTIONS
    bool "Build options is disabled"
    default n

config FX_DISABLE_ONE_LINE_FUNCTION
    bool "One line function is disabled"
    default n

config FX_DIABLE_FAT_ENTRY_REFRESH
    bool "FAT entry refresh is disabled"
    default n

config FX_DISABLE_CONSECUTIVE_DETECT
    bool "Consecutive detect is disabled"
    default y

endif #FILE_SYSTEM_FILEXFS
```

## ui/Kconfig
```kconfig
menuconfig BASEWORK_UI
    bool "Basework UI compoment"
    default n

if BASEWORK_UI

config LVGL_ENCODER
    bool "Enable encoder intput device for lvgl"
    default n
	
config LVGL_LAZY_DECOMP
	bool "Enable picture resource lazy decompress"
	default n

config LVGL_LAZYDECOMP_AUXMEM
	bool "Enable aux memory pool for lazy-cache controller"
	depends on LVGL_LAZY_DECOMP
	default n

config LAZYCACHE_ALIGN_SIZE
	int "LazyCache memory aligned size"
	range 4 128
	default 64

config LAZYCACHE_MAX_NODES
	int "Maximum cache node for lazycache"
	default 64

endif #BASEWORK_UI
```
